#include "torabo_tsuki_lp.dtsi"
#include <input/processors.dtsi>
#include <input/processors/runtime-input-processor.dtsi>
#include <dt-bindings/zmk/input_transform.h>

&mouse_runtime_input_processor {
    // DYA Studio から速度(scale)/回転(rotation)/軸スナップ等を再ビルド無しで実機調整できる。
    // 既定値は従来の zip_xy_transform(X/Y反転) 相当。調整値はStudioのみ保持されソースには戻らない。
    x-invert;
    y-invert;
};

&pointing_listener {
    // ポインタ移動は runtime processor で処理するだけ。レイヤーは自動起動しない。
    // DYA Studio から速度/回転を調整できる。
    input-processors = <&mouse_runtime_input_processor>;

    // L + ; コンボでワンショット layer_4 が有効な間、移動を1/6に減速してスクロールへ変換
    scroller {
        layers = <4>;
        input-processors = <&zip_xy_scaler 1 6>, <&zip_xy_to_scroll_mapper>;
    };
};
